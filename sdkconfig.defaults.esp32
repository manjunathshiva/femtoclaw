## sdkconfig.defaults.esp32
```kconfig
# FemtoClaw - ESP32 (ESP-WROOM-32) Target Configuration
CONFIG_IDF_TARGET="esp32"

# Flash 4MB + QIO
CONFIG_ESPTOOLPY_FLASHSIZE_4MB=y
CONFIG_ESPTOOLPY_FLASHMODE_QIO=y

# CPU 240MHz
CONFIG_ESP_DEFAULT_CPU_FREQ_MHZ_240=y

# No PSRAM on ESP-WROOM-32

# WiFi memory optimization
CONFIG_ESP_WIFI_STATIC_RX_BUFFER_NUM=3
CONFIG_ESP_WIFI_DYNAMIC_RX_BUFFER_NUM=6
CONFIG_ESP_WIFI_RX_BA_WIN=3
CONFIG_LWIP_TCPIP_RECVMBOX_SIZE=16

# TLS optimization (internal RAM, small buffers)
CONFIG_MBEDTLS_DYNAMIC_BUFFER=y
CONFIG_MBEDTLS_DYNAMIC_FREE_CONFIG_DATA=y
CONFIG_MBEDTLS_DYNAMIC_FREE_PEER_CERT=y
CONFIG_MBEDTLS_SSL_IN_CONTENT_LEN=16384
# 4KB OUT buffer is sufficient for LLM API requests; cloud APIs also work at this size.
CONFIG_MBEDTLS_SSL_OUT_CONTENT_LEN=4096

# WebSocket support
CONFIG_HTTPD_WS_SUPPORT=y

# Custom partition table (4MB layout, single factory app)
CONFIG_PARTITION_TABLE_CUSTOM=y
CONFIG_PARTITION_TABLE_CUSTOM_FILENAME="partitions_esp32.csv"

# Console: UART only (no USB Serial/JTAG on ESP-WROOM-32)
CONFIG_ESP_CONSOLE_UART_DEFAULT=y
```
